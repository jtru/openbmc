## meta-gigabyte/conf/layer.conf
```bitbake
# We have a conf and classes directory, add to BBPATH
BBPATH .= ":${LAYERDIR}"

# We have recipes-* directories, add to BBFILES
BBFILES += "${LAYERDIR}/meta-*/recipes-*/*/*.bb \
            ${LAYERDIR}/meta-*/recipes-*/*/*.bbappend"

BBFILE_COLLECTIONS += "gigabyte-layer"
BBFILE_PATTERN_gigabyte-layer = "^${LAYERDIR}/"
LAYERVERSION_gigabyte-layer = "1"
LAYERSERIES_COMPAT_gigabyte-layer = "nanbield scarthgap"
```

## meta-gigabyte/meta-mc12-le0/conf/layer.conf
```bitbake
# We have a conf and classes directory, add to BBPATH
BBPATH .= ":${LAYERDIR}"

# We have recipes-* directories, add to BBFILES
BBFILES += "${LAYERDIR}/meta-*/recipes-*/*/*.bb \
            ${LAYERDIR}/meta-*/recipes-*/*/*.bbappend"

BBFILE_COLLECTIONS += "mc12-le0"
BBFILE_PATTERN_mc12-le0 = "^${LAYERDIR}/"

LAYERSERIES_COMPAT_mc12-le0 = "styhead walnascar"
```

## meta-gigabyte/meta-mc12-le0/conf/machine/mc12-le0.conf
```bitbake
KMACHINE = "aspeed"
KERNEL_DEVICETREE = "gigabyte-mc12-le0.dtb"

#UBOOT_DEVICETREE = "ast2500-gigabyte-mc12-le0.dtb"

# XXX FIXME replace this with the board-specific DTS once I know how to
UBOOT_DEVICETREE = "ast2500-evb"
UBOOT_MACHINE = "evb-ast2500_defconfig"

FLASH_SIZE = "65536"

require conf/machine/include/ast2500.inc
require conf/machine/include/obmc-bsp-common.inc
require conf/machine/include/gigabyte.inc

SERIAL_CONSOLES = "115200;ttyS4"

MACHINEOVERRIDES =. "gigabyte-mc12-le0-u-boot-cfg:"
MACHINEOVERRIDES =. "gigabyte-mc12-le0-devicetree:"
```
